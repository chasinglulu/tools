## scripts/example/bl31.its
```
/dts-v1/;
/ {
    description = "ATF image";
    #address-cells = <2>;
    images {
        firmware-1 {
            data = /incbin/("bl31.bin");
            description = "ARM Trusted Firmware";
            type = "firmware";
            arch = "arm64";
            os = "arm-trusted-firmware";
            compression = "none";
            load = <0x1 0x00104000>;
            entry = <0x1 0x00104000>;
            hash-1 {
                algo = "sha256";
            };
        };
    };
    configurations {
        default = "conf-1";
        conf-1 {
            description = "ATF firmware";
            firmware = "firmware-1";
            loadables = "firmware-1";
            signature {
                sign-images = "firmware";
                algo = "sha256,rsa2048";
                key-name-hint = "akcipher2048";
            };
        };
    };
};
```

## scripts/example/extlinux.its
```
/dts-v1/;
/ {
    description = "Linux boot configuration files";
    #address-cells = <2>;
    images {
        firmware-1 {
            data = /incbin/("extlinux.conf");
            description = "extlinux.conf";
            type = "firmware";
            arch = "arm64";
            os = "linux";
            compression = "none";
            load = <0x1 0x0FF00000>;
            hash-1 {
                algo = "sha256";
            };
        };
    };
    configurations {
        default = "conf-1";
        conf-1 {
            description = "extlinux.conf";
            firmware = "firmware-1";
            loadables = "firmware-1";
            signature {
                sign-images = "firmware";
                algo = "sha256,rsa2048";
                key-name-hint = "akcipher2048";
            };
        };
    };
};
```

## scripts/example/kernel.its
```
/dts-v1/;
/ {
    description = "kernel image with one or more FDT blobs";
    #address-cells = <2>;
    images {
        kernel {
            data = /incbin/("Image");
            description = "Linux";
            type = "kernel";
            arch = "arm64";
            os = "linux";
            compression = "none";
            load = <0x1 0x10000000>;
            entry = <0x1 0x10000000>;
            kernel-version = <1>;
            hash-1 {
                algo = "sha256";
            };
        };
        ramdisk-1 {
            description = "ramdisk";
            data = /incbin/("rootfs.cpio.lz4");
            type = "ramdisk";
            arch = "arm64";
            os = "linux";
            load = <0x1 0x19000000>;
            hash-1 {
                algo = "sha256";
            };
        };
        fdt-1 {
            description = "m57h kernel FDT";
            data = /incbin/("m57h.dtb");
            type = "flat_dt";
            arch = "arm64";
            load = <0x1 0x18000000>;
            compression = "none";
            fdt-version = <1>;
            hash-1 {
                algo = "sha256";
            };
        };
    };
    configurations {
        default = "conf-1";
        conf-1 {
            description = "m57h";
            kernel = "kernel";
            fdt = "fdt-1";
            ramdisk = "ramdisk-1";
            signature {
                sign-images = "fdt", "ramdisk", "kernel";
                algo = "sha256,rsa2048";
                key-name-hint = "akcipher2048";
            };
        };
    };
};
```

## scripts/example/multi_spl.its
```
/dts-v1/;
/ {
	description = "multiple firmware blobs and U-Boot, loaded by SPL";
	#address-cells = <2>;
	images {
		u-boot {
			data = /incbin/("u-boot-dtb.bin");
			description = "U-Boot";
			type = "firmware";
			arch = "arm64";
			os = "u-boot";
			compression = "none";
			load = <0x1 0x00200000>;
			entry = <0x1 0x00200000>;
			hash-1 {
				algo = "sha256";
			};
		};
		atf {
			data = /incbin/("bl31.bin");
			description = "ARM Trusted Firmware";
			type = "firmware";
			arch = "arm64";
			os = "arm-trusted-firmware";
			compression = "none";
			load = <0x1 0x00104000>;
			entry = <0x1 0x00104000>;
			hash-1 {
				algo = "sha256";
			};
		};
		optee {
			data = /incbin/("tee-pager_v2.bin");
			description = "Trusted Execution Environment Image";
			type = "firmware";
			arch = "arm64";
			os = "tee";
			compression = "none";
			load = <0x1 0x04000000>;
			entry = <0x1 0x04000000>;
			hash-1 {
				algo = "sha256";
			};
		};
	};
	configurations {
		default = "conf-1";
		conf-1 {
			description = "SPL Multiple Firmwares";
			firmware = "u-boot", "atf", "optee";
			loadables = "u-boot", "atf", "optee";
			signature {
				sign-images = "firmware";
				algo = "sha256,rsa2048";
				key-name-hint = "akcipher2048";
			};
		};
	};
};
```

## scripts/example/tee.its
```
/dts-v1/;
/ {
    description = "Trusted Execution Environment Image";
    #address-cells = <2>;
    images {
        firmware-1 {
            data = /incbin/("tee-pager_v2.bin");
            description = "Trusted Execution Environment Image";
            type = "firmware";
            arch = "arm64";
            os = "tee";
            compression = "none";
            load = <0x1 0x04000000>;
            entry = <0x1 0x04000000>;
            hash-1 {
                algo = "sha256";
            };
        };
    };
    configurations {
        default = "conf-1";
        conf-1 {
            description = "OP-TEE";
            firmware = "firmware-1";
            loadables = "firmware-1";
            signature {
                sign-images = "firmware";
                algo = "sha256,rsa2048";
                key-name-hint = "akcipher2048";
            };
        };
    };
};
```

## scripts/example/u-boot.its
```
/dts-v1/;
/ {
    description = "U-Boot image with one FDT blob";
    #address-cells = <2>;
    images {
        firmware-1 {
            data = /incbin/("u-boot-dtb.bin");
            description = "U-Boot";
            type = "firmware";
            arch = "arm64";
            os = "u-boot";
            compression = "none";
            load = <0x1 0x00200000>;
            entry = <0x1 0x00200000>;
            hash-1 {
                algo = "sha256";
            };
        };
    };
    configurations {
        default = "conf-1";
        conf-1 {
            description = "U-Boot";
            firmware = "firmware-1";
            loadables = "firmware-1";
            signature {
                sign-images = "firmware";
                algo = "sha256,rsa2048";
                key-name-hint = "akcipher2048";
            };
        };
    };
};
```
